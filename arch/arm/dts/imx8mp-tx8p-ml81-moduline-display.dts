// SPDX-License-Identifier: (GPL-2.0 OR MIT)
/*
 * Copyright (C) 2025 Maud Spierings <maudspierings@gocontroll.com>
 */

/dts-v1/;

#include "imx8mp-tx8p-ml81.dtsi"

/ {
	model = "GOcontroll Moduline Display";
	compatible = "gocontroll,moduline-display", "fsl,imx8mp";
};

&uart1 {
	pinctrl-names = "default";
	pinctrl-0 = <&pinctrl_uart1>;
	status = "okay";
};

&iomuxc {
	pinctrl_uart1: uart1grp {
		fsl,pins = <
			MX8MP_IOMUXC_UART1_RXD__UART1_DCE_RX		0x140
			MX8MP_IOMUXC_UART1_TXD__UART1_DCE_TX		0x140
		>;
	};
};
